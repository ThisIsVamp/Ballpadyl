## boards/shields/ballpadyl/Kconfig.defconfig
```kconfig
if SHIELD_BALLPADYL_LEFT

# Name must be less than 16 characters long!
config ZMK_KEYBOARD_NAME
    default "ballpadyl"

config ZMK_SPLIT_ROLE_CENTRAL
    default y

endif

if SHIELD_BALLPADYL_LEFT || SHIELD_BALLPADYL_RIGHT

config ZMK_SPLIT
    default y

endif
```

## boards/shields/ballpadyl/Kconfig.shield
```kconfig
# No whitespace after the comma or in your part name!
config SHIELD_BALLPADYL_LEFT
    def_bool $(shields_list_contains,ballpadyl_right)

# No whitespace after the comma or in your part name!
config SHIELD_BALLPADYL_RIGHT
    def_bool $(shields_list_contains,ballpadyl_right)
```
